## br-ext/package/optee_quic/Config.in
```kconfig
config BR2_PACKAGE_OPTEE_QUIC
	bool "optee_quic"
	help
	  optee_quic project

if BR2_PACKAGE_OPTEE_QUIC

config BR2_PACKAGE_OPTEE_QUIC_SITE
	string "OP-TEE quic path"
	default ""
	help
	  The path to the source directory of OP-TEE quic

config BR2_PACKAGE_OPTEE_QUIC_SDK
	string "OPTEE SDK path"
	default ""
	help
	  some help

config BR2_PACKAGE_OPTEE_QUIC_CROSS_COMPILE
	string "OPTEE cross compiler"
	default ""
	help
	  some help

endif
```
